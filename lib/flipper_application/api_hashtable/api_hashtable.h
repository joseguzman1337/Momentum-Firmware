#pragma once

#include <flipper_application/elf/elf_api_interface.h>

#include <stdint.h>

#ifdef __cplusplus
extern "C" {
#endif

/**
 * @brief Symbol table entry
 */
struct sym_entry {
    uint32_t hash;
    uint32_t address;
};

/**
 * @brief Resolver for API entries using a pre-sorted table with hashes
 * @param interface pointer to HashtableApiInterface
 * @param hash gnu hash of function name
 * @param address output for function address
 * @return true if the table contains a function
 */
bool elf_resolve_from_hashtable(
    const ElfApiInterface* interface,
    uint32_t hash,
    Elf32_Addr* address);

uint32_t elf_symbolname_hash(const char* s);

#ifdef __cplusplus
}

#include <array>
#include <algorithm>

/**
 * @brief  HashtableApiInterface is an implementation of ElfApiInterface
 * that uses a hash table to resolve function addresses.
 * table_cbegin and table_cend must point to a sorted array of sym_entry
 */
struct HashtableApiInterface : public ElfApiInterface {
    const uint8_t* hash_low;
    const uint8_t* hash_high;
    const uint32_t* addresses;
    uint16_t count;
    uint8_t low_width;
};

/** Compile-time Elias-Fano storage for application-private API tables.
 *
 * Firmware API tables are generated by fbt, while private plugin APIs are
 * declared as constexpr sym_entry arrays. This adapter lets both producers use
 * the same compact resolver without keeping a second runtime lookup format.
 */
template <std::size_t N>
struct PackedHashtable {
    static_assert(N > 0, "API table must not be empty");

    static constexpr uint8_t low_width = []() constexpr {
        uint64_t quotient = (UINT64_C(1) << 32) / N;
        uint8_t width = 0;
        while(quotient > 1) {
            quotient >>= 1;
            ++width;
        }
        return width;
    }();
    static constexpr std::size_t low_bytes = (N * low_width + 7) / 8;
    static constexpr std::size_t high_bits =
        N + static_cast<std::size_t>(UINT64_C(0xFFFFFFFF) >> low_width) + 1;
    static constexpr std::size_t high_bytes = (high_bits + 7) / 8;

    /* Three zero pad bytes make the resolver's unaligned 32-bit window valid
       for the final packed value as well. */
    std::array<uint8_t, low_bytes + 3> hash_low{};
    std::array<uint8_t, high_bytes> hash_high{};
    std::array<uint32_t, N> addresses{};

    constexpr explicit PackedHashtable(const std::array<sym_entry, N>& entries) {
        constexpr uint64_t low_mask =
            low_width == 32 ? UINT64_C(0xFFFFFFFF) : ((UINT64_C(1) << low_width) - 1);
        for(std::size_t index = 0; index < N; ++index) {
            const uint32_t hash = entries[index].hash;
            const uint32_t low = static_cast<uint32_t>(hash & low_mask);
            const std::size_t low_bit = index * low_width;
            for(uint8_t shift = 0; shift < low_width; ++shift) {
                if(low & (UINT32_C(1) << shift)) {
                    hash_low[(low_bit + shift) / 8] |= UINT8_C(1) << ((low_bit + shift) % 8);
                }
            }
            const std::size_t high_position =
                (low_width == 32 ? 0 : (hash >> low_width)) + index;
            hash_high[high_position / 8] |= UINT8_C(1) << (high_position % 8);
            addresses[index] = entries[index].address;
        }
    }
};

template <std::size_t N>
constexpr PackedHashtable<N> pack_hashtable(const std::array<sym_entry, N>& entries) {
    return PackedHashtable<N>(entries);
}

#define API_ADDRESS_METHOD(x, ret_type, args_type) \
    (uint32_t)(static_cast<ret_type(*) args_type>(x))
#define API_ADDRESS_VARIABLE(x, var_type) (uint32_t)(&(x))

#define API_METHOD(x, ret_type, args_type)                                                     \
    sym_entry {                                                                                \
        .hash = elf_gnu_hash(#x), .address = (uint32_t)(static_cast<ret_type(*) args_type>(x)) \
    }

#define API_VARIABLE(x, var_type)                              \
    sym_entry {                                                \
        .hash = elf_gnu_hash(#x), .address = (uint32_t)(&(x)), \
    }

constexpr bool operator<(const sym_entry& k1, const sym_entry& k2) {
    return k1.hash < k2.hash;
}

/**
 * @brief Calculate hash for a string using the ELF GNU hash algorithm
 * @param s string to calculate hash for
 * @return hash value
 */
constexpr uint32_t elf_gnu_hash(const char* s) {
    uint32_t h = 0x1505;
    for(unsigned char c = *s; c != '\0'; c = *++s) {
        h = (h << 5) + h + c;
    }
    return h;
}

/* Compile-time check for hash collisions in API table.
 * Usage: static_assert(!has_hash_collisions(api_methods), "Hash collision detected"); 
 */
template <std::size_t N>
constexpr bool has_hash_collisions(const std::array<sym_entry, N>& api_methods) {
    for(std::size_t i = 0; i < (N - 1); ++i) {
        if(api_methods[i].hash == api_methods[i + 1].hash) {
            return true;
        }
    }

    return false;
}

#endif
